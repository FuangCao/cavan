## driver/Kconfig
```kconfig
menu "Cavan driver config"

choice
    prompt "Phone type"
    default CAVAN_ZTE_HS8801
    depends on MACH_SP8810 || MACH_SP8810G_BRCM
    help
      Choice cavan phone type

config CAVAN_ZTE_HS8801
    depends on MACH_SP8810
    bool "ZTE HS8801"
    help
      Support for the ZTE HS8801 based phone
endchoice

config CAVAN_USB_VENDOR_ID
    hex "USB vendor id"
    default 0x1782

config CAVAN_USB_PRODUCT_ID
    hex "USB product id"
    default 0x5D00

config CAVAN_USB_RNDIS_PRODUCT_ID
    hex "USB rndis product id"
    default 0x5D20

config CAVAN_USB_SIMPLE_NAME
    string "USB simple name"
    default "Cavan"

config CAVAN_USB_MANUFACTURER_NAME
    string "USB manufacturer name"
    default "Cavan"

config CAVAN_USB_PRODUCT_NAME
    string "USB product name"
    default "Cavan"

config CAVAN_USB_SERIAL_NUMBER
    string "USB serial number"
    default "19761202"

config CAVAN_LCD_WIDTH
    int "LCD width"
    range 0 4096
	default 480
    help
      This option config lcd horizontal resolution.

config CAVAN_LCD_HEIGHT
    int "LCD height"
    range 0 4096
	default 800
    help
      This option config lcd vertical resolution.

config CAVAN_LCD_BUS_WIDTH
    int "LCD bus width"
    range 0 32
	default 24
    help
      This option config lcd bus width.

choice
    prompt "LCD backlight type"
    default CAVAN_LCD_BACKLIGHT_GPIO
    help
      Choice cavan lcd lcd backlight type

config CAVAN_LCD_BACKLIGHT_GPIO
    bool "Backlight type gpio"
    help
      Use gpio control backlight brightness

config CAVAN_LCD_BACKLIGHT_ANA
    bool "Backlight type ana"
    help
      Use analog control backlight brightness

config CAVAN_LCD_BACKLIGHT_PWM
    bool "Backlight type pwm"
    help
      Use pwm control backlight brightness
endchoice

config CAVAN_LCD_BACKLIGHT_MAX_BRIGHTNESS
    int "LCD backlight max brightness"
    range 0 255
	default 255
    help
      This option config lcd backlight max brightness.

config CAVAN_LCD_SUPPORT_VENDOR_ID
    bool "LCD support vendor id"
	default n
    help
      Say Y here if your lcd support vendor id

      If unsure, say N.

config CAVAN_BUTTON_BACKLIGHT_MAX_BRIGHTNESS
    int "Button backlight max brightness"
    range 0 255
	default 255
    help
      This option config button backlight max brightness.

config USE_EXTERNAL_POWER_AMPLIFIER
	bool "Use external power amplifier"
	default n
	help
	  Select if use external power amplifier.

config MMC_DEV_TROUT
	bool "Mmc device for trout"
	default n
	help
	  Select if use trout wifi.

config EXCHANGE_VOLUME_KEY
	bool "Exchange volume key"
	default n
	help
	  Select if need exchange volume key.

config CAVAN_CAMERA_ROTATION
	int "Camera rotation degree"
	range 0 270
	default 0
	help
	  This option config the rotation of camera sensor

config CAVAN_SUPPORT_BACK_CAMERA
	bool "Support back camera"
	default n
	help
	  Select if has a back camera.

config CAVAN_SUPPORT_FRONT_CAMERA
	bool "Support front camera"
	default n
	help
	  Select if has a front camera.

menuconfig CAVAN_INPUT_CORE
    tristate "Input subsystem"
    default n
    depends on INPUT
    help
      Say Y here if you want to use cavan input subsystem

      If unsure, say Y.

if CAVAN_INPUT_CORE
source "drivers/cavan/sensor/Kconfig"
source "drivers/cavan/touchscreen/Kconfig"
endif

source "drivers/cavan/flash/Kconfig"
source "drivers/cavan/misc/Kconfig"

endmenu
```

## driver/flash/Kconfig
```kconfig
menu "Cavan flash driver config"

config CAVAN_FLASH_W25Q32FW
    tristate "Cavan w25q32fw spi flash support"
    default n
    help
      Say Y here if you have Winbond's w25qxx falsh hooked
      to an SPI bus.

      If unsure, say N.

      To compile this driver as a module, choose M here: the
      module will be called spi-w25q32fw.

endmenu
```

## driver/gpio/Kconfig
```kconfig
menu "Gpio devices"

config CAVAN_GPIO_TCA9535
    tristate "tca9535 gpio support"
    default n
    help
      Say Y here if you have TI's tca9535 gpio controller hooked
      to an I2C bus.

      If unsure, say N.

      To compile this driver as a module, choose M here: the
      module will be called gpio-tca9535.

config CAVAN_GPIO_KEYPAD
    tristate "gpio keypad support"
    default n
    help
      Say Y here if you have need a gpio keypad.

      If unsure, say N.

      To compile this driver as a module, choose M here: the
      module will be called gpio-keypad.

endmenu
```

## driver/leds/Kconfig
```kconfig
menu "LED devices"

config CAVAN_LEDS_PCA9685
    tristate "LED support for PCA9685 I2C chip"
    default n
    depends on LEDS_CLASS
    depends on I2C
    help
      This option enables support for LEDs connected to the PCA9685
      LED driver chip accessed via the I2C bus.

config CAVAN_LEDS_AW2013
    tristate "LED support for AW2013 I2C chip"
    default n
    depends on LEDS_CLASS
    depends on I2C
    help
      This option enables support for LEDs connected to the AW2013
      LED driver chip accessed via the I2C bus.

endmenu
```

## driver/misc/Kconfig
```kconfig
menu "Misc driver config"

config CAVAN_MISC_SWAN_VK
    tristate "swan virtual keypad support"
    default n
    help
      Say Y here if you need swan virtual keypad support.

      If unsure, say N.

      To compile this driver as a module, choose M here: the
      module will be called swan_vk.

config CAVAN_MISC_SWAN_VN
    tristate "swan virtual network card support"
    default n
    help
      Say Y here if you need swan virtual network card support.

      If unsure, say N.

      To compile this driver as a module, choose M here: the
      module will be called swan_vn.

config CAVAN_MISC_TCP_KEYPAD
    tristate "tcp keypad support"
    default n
    help
      Say Y here if you need tcp virtual keypad support.

      If unsure, say N.

      To compile this driver as a module, choose M here: the
      module will be called tcp_keypad.

config CAVAN_LEDS_PCA9685
    tristate "LED support for PCA9685 I2C chip"
    default n
    depends on LEDS_CLASS
    depends on I2C
    help
      This option enables support for LEDs connected to the PCA9685
      LED driver chip accessed via the I2C bus.

endmenu
```

## driver/sensor/Kconfig
```kconfig
menu "Sensor devices"

config CAVAN_GSENSOR_EXCHANGE_XY
    bool "GSensor exchange x and y axis"
    default n
    help
      Say Y if you whant to exchange x and y axis

      If unsure, say N.

config CAVAN_GSENSOR_SIGN_X
    int "GSensor sign of x axis"
    default 1
    range -1 1
    help
      This option config sign of x axis.

config CAVAN_GSENSOR_SIGN_Y
    int "GSensor sign of y axis"
    default 1
    range -1 1
    help
      This option config sign of y axis.

config CAVAN_GSENSOR_SIGN_Z
    int "GSensor sign of z axis"
    default 1
    range -1 1
    help
      This option config sign of z axis.

config CAVAN_GYROSCOPE_EXCHANGE_XY
    bool "Gyroscope exchange x and y axis"
    default n
    help
      Say Y if you whant to exchange x and y axis

      If unsure, say N.

config CAVAN_GYROSCOPE_SIGN_X
    int "Gyroscope sign of x axis"
    default 1
    range -1 1
    help
      This option config sign of x axis.

config CAVAN_GYROSCOPE_SIGN_Y
    int "Gyroscope sign of y axis"
    default 1
    range -1 1
    help
      This option config sign of y axis.

config CAVAN_GYROSCOPE_SIGN_Z
    int "Gyroscope sign of z axis"
    default 1
    range -1 1
    help
      This option config sign of z axis.

config CAVAN_SENSOR_DUMMY
    tristate "Dummy sensor support"
    default n
    help
      Say Y here if you need a dummy sensor for test.

      If unsure, say Y.

      To compile this driver as a module, choose M here: the
      module will be called cavan_dummy.

config CAVAN_SENSOR_ADXL34X
    tristate "ADXL346 g-sensor support"
    default n
    help
      Say Y here if you have a ADXL346 g-sendor connected to
      your system.

      If unsure, say Y.

      To compile this driver as a module, choose M here: the
      module will be called cavan_adxl34x.

config CAVAN_SENSOR_KIONIX
    tristate "KXCJK KXTIK g-sensor support"
    default n
    help
      Say Y here if you have a KIONIX KXCJK KXTIK g-sendor connected to
      your system.

      If unsure, say Y.

      To compile this driver as a module, choose M here: the
      module will be called cavan_kionix.

config CAVAN_SENSOR_LIS3DH
    tristate "LIS3DH LIS3DE g-sensor support"
    default n
    help
      Say Y here if you have LIS3DH or LIS3DE g-sendor connected to
      your system.

      If unsure, say Y.

      To compile this driver as a module, choose M here: the
      module will be called cavan_lis3dh.

config CAVAN_SENSOR_MMA845X
    tristate "MMA845X g-sensor support"
    default n
    help
      Say Y here if you have a MMA845X g-sendor connected to
      your system.

      If unsure, say Y.

      To compile this driver as a module, choose M here: the
      module will be called cavan_mma845x.

config CAVAN_SENSOR_MXC6225
    tristate "MXC6225-XC MXC6225-XU g-sensor support"
    default n
    help
      Say Y here if you have a MXC6225-XC or MXC6225-XU g-sendor connected to
      your system.

      If unsure, say Y.

      To compile this driver as a module, choose M here: the
      module will be called cavan_mxc6225.

config CAVAN_SENSOR_STK8313
    tristate "STK8313 g-sensor support"
    default n
    help
      Say Y here if you have a STK8313 g-sendor connected to
      your system.

      If unsure, say Y.

      To compile this driver as a module, choose M here: the
      module will be called cavan_stk8313.

config CAVAN_SENSOR_BMA2XX
    tristate "BMA2XX g-sensor support"
    default n
    help
      Say Y here if you have a BMA2XX g-sendor connected to
      your system.

      If unsure, say Y.

      To compile this driver as a module, choose M here: the
      module will be called cavan_bma2xx.

config CAVAN_SENSOR_MC3XXX
    tristate "MC3XXX g-sensor support"
    default n
    help
      Say Y here if you have a MC3XXX g-sendor connected to
      your system.

      If unsure, say Y.

      To compile this driver as a module, choose M here: the
      module will be called cavan_mc3xxx.

config CAVAN_SENSOR_APDS99XX
    tristate "APDS99XX l-sensor and p-sensor support"
    default n
    help
      Say Y here if you have a APDS99XX light or proximity sendor connected to
      your system.

      If unsure, say Y.

      To compile this driver as a module, choose M here: the
      module will be called cavan_apds99xx.

config CAVAN_SENSOR_EPL2182
    tristate "EPL2182 l-sensor and p-sensor support"
    default n
    help
      Say Y here if you have a EPL2182 light or proximity sendor connected to
      your system.

      If unsure, say Y.

      To compile this driver as a module, choose M here: the
      module will be called cavan_epl2182.

config CAVAN_SENSOR_BMI160
    tristate "BMI160 acceleration and gyroscope sensor support"
    default n
    help
      Say Y here if you have Bosch Sensortec's BMI160
      acceleration and gyroscope sensor hooked to an I2C bus.

      If unsure, say Y.

      To compile this driver as a module, choose M here: the
      module will be called cavan_bmi160.

config CAVAN_SENSOR_BMM150
    tristate "BMM150 geomagnetic sensor support"
    default n
    help
      Say Y here if you have Bosch Sensortec's BMM150
      acceleration and gyroscope sensor hooked to an I2C bus.

      If unsure, say Y.

      To compile this driver as a module, choose M here: the
      module will be called cavan_bmm150.

config CAVAN_SENSOR_LTR553
    tristate "LTR553 l-sensor and p-sensor support"
    default n
    help
      Say Y here if you have a LTR553 light or proximity sendor connected to
      your system.

      If unsure, say Y.

      To compile this driver as a module, choose M here: the
      module will be called cavan_ltr553.

endmenu
```

## driver/touchscreen/Kconfig
```kconfig
menu "Touchscreen driver config"

config CAVAN_USE_FB_NOTIFILER
    bool "Use fb notifiter control touchscreen power"
    default n
	help
      Say Y here if you want to use fb notifiter control touchscreen power.

      If unsure, say N.

config CAVAN_TOUCHSCREEN_BL86X8
    tristate "bl86x8 touchscreen support"
    default n
    help
      Say Y here if you have a bl86x8 touchscreen connected to
      your system.

      If unsure, say Y.

      To compile this driver as a module, choose M here: the
      module will be called hampshire.

config CAVAN_TOUCHSCREEN_CY8C242
    tristate "cy8c242 touchscreen support"
    default n
    help
      Say Y here if you have a cy8c242 touchscreen connected to
      your system.

      If unsure, say Y.

      To compile this driver as a module, choose M here: the
      module will be called hampshire.

config CAVAN_TOUCHSCREEN_FT5216
    tristate "ft5216 ft6306 touchscreen support"
    default n
    help
      Say Y here if you have a ft5216 touchscreen connected to
      your system.

      If unsure, say Y.

      To compile this driver as a module, choose M here: the
      module will be called hampshire.

config CAVAN_TOUCHSCREEN_MSG21XX
    tristate "msg21xx touchscreen support"
    default n
    help
      Say Y here if you have a msg21xx touchscreen connected to
      your system.

      If unsure, say Y.

      To compile this driver as a module, choose M here: the
      module will be called hampshire.

endmenu
```
